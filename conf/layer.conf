## conf/layer.conf
```bitbake
# We have a conf and classes directory, add to BBPATH
BBPATH .= ":${LAYERDIR}"

# We have recipes-* directories, add to BBFILES
BBFILES += "${LAYERDIR}/recipes-*/*/*.bb \
            ${LAYERDIR}/recipes-*/*/*.bbappend"

BBFILE_COLLECTIONS += "meta-molybdenum"
BBFILE_PATTERN_meta-molybdenum = "^${LAYERDIR}/"
BBFILE_PRIORITY_meta-molybdenum = "6"

LAYERDEPENDS_meta-molybdenum = "core"
LAYERSERIES_COMPAT_meta-molybdenum = "gatesgarth"
```
